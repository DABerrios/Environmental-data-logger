#include <lmic.h>
#include <hal/hal.h>
#include <SPI.h>

#include <Lora_otaa.h>
#include <BDL.h>
#include <main.h>
#include <sleep_func.h>
#include <data_processing.h>


#ifdef COMPILE_REGRESSION_TEST
# define FILLMEIN 0
#else
# warning "You must replace the values marked FILLMEIN with real values from the TTN control panel!"
# define FILLMEIN (#dont edit this, edit the lines that use FILLMEIN)
#endif

// This EUI must be in little-endian format, so least-significant-byte
// first. When copying an EUI from ttnctl output, this means to reverse
// the bytes. For TTN issued EUIs the last bytes should be 0xD5, 0xB3,
// 0x70.
static const u1_t PROGMEM APPEUI[8]={ 0x00, 0x00, 0x00, 0x00, 0x00, 0x00, 0x00, 0x00 };
void os_getArtEui (u1_t* buf) { memcpy_P(buf, APPEUI, 8);}

// This should also be in little endian format, see above.
static const u1_t PROGMEM DEVEUI[8]={ 0x70, 0xD4, 0x06, 0xD0, 0x7E, 0xD5, 0xB3, 0x70 };
void os_getDevEui (u1_t* buf) { memcpy_P(buf, DEVEUI, 8);}

// This key should be in big endian format (or, since it is not really a
// number but a block of memory, endianness does not really apply). In
// practice, a key taken from ttnctl can be copied as-is.
static const u1_t PROGMEM APPKEY[16] = { 0x77, 0x15, 0x51, 0xEA, 0xB4, 0xBD, 0x65, 0xE5, 0x2D, 0xFB, 0x3B, 0xE7, 0x67, 0xFB, 0xEF, 0x32 };
void os_getDevKey (u1_t* buf) {  memcpy_P(buf, APPKEY, 16);}

uint8_t mydata[15];
size_t ind = 0;
static uint8_t data2[]={"test"};

static osjob_t sendjob;

// Schedule TX every this many seconds (might become longer due to duty
// cycle limitations).
const unsigned TX_INTERVAL = 60;

// Pin mapping
const lmic_pinmap lmic_pins = {
    .nss = SX1276_CS,
    .rxtx = LMIC_UNUSED_PIN,
    .rst = SX1276_RST,
    .dio = {SX1276_DIO0, SX1276_DIO1, LMIC_UNUSED_PIN},
    
};

void printHex2(unsigned v) {
    v &= 0xff;
    if (v < 16)
        Serial.print('0');
    Serial.print(v, HEX);
}

/**
 * @brief Handles events generated by the LoRaWAN stack.
 *
 * This function is called whenever an event occurs in the LoRaWAN stack.
 * It prints the event type and additional information to the serial console.
 *
 * @param ev The event type.
 *
 * Event types handled:
 * - EV_SCAN_TIMEOUT: Scanning for a network timed out.
 * - EV_BEACON_FOUND: A beacon was found.
 * - EV_BEACON_MISSED: A beacon was missed.
 * - EV_BEACON_TRACKED: A beacon is being tracked.
 * - EV_JOINING: The device is attempting to join a network.
 * - EV_JOINED: The device successfully joined a network.
 * - EV_JOIN_FAILED: The device failed to join a network.
 * - EV_REJOIN_FAILED: The device failed to rejoin a network.
 * - EV_TXCOMPLETE: A transmission was completed.
 * - EV_LOST_TSYNC: Lost time synchronization.
 * - EV_RESET: The device was reset.
 * - EV_RXCOMPLETE: Data was received in a ping slot.
 * - EV_LINK_DEAD: The link is dead.
 * - EV_LINK_ALIVE: The link is alive.
 * - EV_TXSTART: A transmission is starting.
 * - EV_TXCANCELED: A transmission was canceled.
 * - EV_RXSTART: Reception is starting.
 * - EV_JOIN_TXCOMPLETE: No JoinAccept was received.
 * - Default: An unknown event occurred.
 */
void onEvent (ev_t ev) {
    Serial.print(os_getTime());
    Serial.print(": ");
    switch(ev) {
        case EV_SCAN_TIMEOUT:
            Serial.println(F("EV_SCAN_TIMEOUT"));
            break;
        case EV_BEACON_FOUND:
            Serial.println(F("EV_BEACON_FOUND"));
            break;
        case EV_BEACON_MISSED:
            Serial.println(F("EV_BEACON_MISSED"));
            break;
        case EV_BEACON_TRACKED:
            Serial.println(F("EV_BEACON_TRACKED"));
            break;
        case EV_JOINING:
            Serial.println(F("EV_JOINING"));
            break;
        case EV_JOINED:
            Serial.println(F("EV_JOINED"));
            {
              u4_t netid = 0;
              devaddr_t devaddr = 0;
              u1_t nwkKey[16];
              u1_t artKey[16];
              LMIC_getSessionKeys(&netid, &devaddr, nwkKey, artKey);
              Serial.print("netid: ");
              Serial.println(netid, DEC);
              Serial.print("devaddr: ");
              Serial.println(devaddr, HEX);
              Serial.print("AppSKey: ");
              for (size_t i=0; i<sizeof(artKey); ++i) {
                if (i != 0)
                  Serial.print("-");
                printHex2(artKey[i]);
              }
              Serial.println("");
              Serial.print("NwkSKey: ");
              for (size_t i=0; i<sizeof(nwkKey); ++i) {
                      if (i != 0)
                              Serial.print("-");
                      printHex2(nwkKey[i]);
              }
              Serial.println();
            }
            // Disable link check validation (automatically enabled
            // during join, but because slow data rates change max TX
	    // size, we don't use it in this example.
            LMIC_setLinkCheckMode(0);
            break;
        /*
        || This event is defined but not used in the code. No
        || point in wasting codespace on it.
        ||
        || case EV_RFU1:
        ||     Serial.println(F("EV_RFU1"));
        ||     break;
        */
        case EV_JOIN_FAILED:
            Serial.println(F("EV_JOIN_FAILED"));
            break;
        case EV_REJOIN_FAILED:
            Serial.println(F("EV_REJOIN_FAILED"));
            break;
        case EV_TXCOMPLETE:
            Serial.println(F("EV_TXCOMPLETE (includes waiting for RX windows)"));
            if (LMIC.txrxFlags & TXRX_ACK)
              Serial.println(F("Received ack"));
            if (LMIC.dataLen) {
              Serial.print(F("Received "));
              Serial.print(LMIC.dataLen);
              Serial.println(F(" bytes of payload"));
            }
            
            // Schedule next transmission
            os_setTimedCallback(&sendjob, os_getTime()+sec2osticks(TX_INTERVAL), do_send);
            loraWANActive = false;
            break;
        case EV_LOST_TSYNC:
            Serial.println(F("EV_LOST_TSYNC"));
            break;
        case EV_RESET:
            Serial.println(F("EV_RESET"));
            break;
        case EV_RXCOMPLETE:
            // data received in ping slot
            Serial.println(F("EV_RXCOMPLETE"));
            break;
        case EV_LINK_DEAD:
            Serial.println(F("EV_LINK_DEAD"));
            break;
        case EV_LINK_ALIVE:
            Serial.println(F("EV_LINK_ALIVE"));
            break;
        /*
        || This event is defined but not used in the code. No
        || point in wasting codespace on it.
        ||
        || case EV_SCAN_FOUND:
        ||    Serial.println(F("EV_SCAN_FOUND"));
        ||    break;
        */
        case EV_TXSTART:
            Serial.println(F("EV_TXSTART"));
            break;
        case EV_TXCANCELED:
            Serial.println(F("EV_TXCANCELED"));
            break;
        case EV_RXSTART:
            /* do not print anything -- it wrecks timing */
            break;
        case EV_JOIN_TXCOMPLETE:
            Serial.println(F("EV_JOIN_TXCOMPLETE: no JoinAccept"));
            break;

        default:
            Serial.print(F("Unknown event: "));
            Serial.println((unsigned) ev);
            break;
    }
}

void do_send_ext(){
    do_send(&sendjob);
}
/**
 * @brief Sends data using LoRaWAN protocol.
 *
 * This function checks if there is an ongoing TX/RX job. If there is no ongoing job,
 * it prepares and queues the data for upstream transmission at the next possible time.
 *
 * @param j Pointer to the osjob_t structure.
 *
 * The function performs the following steps:
 * - Checks if the LMIC library is currently busy with a TX/RX job.
 * - If not busy, it prints the data to be sent to the Serial monitor.
 * - Queues the data for transmission using the LMIC_setTxData2 function.
 * - Prints a confirmation message to the Serial monitor once the packet is queued.
 *
 * Note: The next transmission is scheduled after the TX_COMPLETE event.
 */
void do_send(osjob_t* j){
    // Check if there is not a current TX/RX job running
    if (LMIC.opmode & OP_TXRXPEND) {
        Serial.println(F("OP_TXRXPEND, not sending"));
    } else {
        // Prepare upstream data transmission at the next possible time.
        for (size_t i = 0; i < ind; i++) {
            Serial.print(mydata[i]);
            if (i < ind - 1) {
            Serial.print(" ");
            }
        }
        Serial.println();
        LMIC_setTxData2(1,mydata , ind, 0);
        Serial.println(F("Packet queued"));
    }
    // Next TX is scheduled after TX_COMPLETE event.
}



/**
 * @brief Initializes the LoRa OTAA (Over The Air Activation) configuration.
 * 
 * This function sets up the SPI interface for the SX1276 LoRa module, initializes the 
 * LoRaMAC-in-C library (LMIC), and configures the LoRa settings for OTAA.
 * 
 * The following steps are performed:
 * - Initializes the SPI interface with specified pins.
 * - Sets the SPI frequency to 4 MHz.
 * - Initializes the LMIC library.
 * - Resets the LMIC state.
 * - Disables link check mode.
 * - Sets the data rate and transmission power.
 * - Selects the sub-band for communication.
 * - Initiates the first send job.
 */
void initLoraotaa(){
    SPI.begin(SX1276_SCK, SX1276_MISO, SX1276_MOSI, SX1276_CS);
    SPI.setFrequency(8E6); 
    os_init();
    LMIC_reset();
    LMIC_setLinkCheckMode(0);
    LMIC_setDrTxpow(DR_SF7,14);
    LMIC_selectSubBand(1);
    do_send(&sendjob);  
}